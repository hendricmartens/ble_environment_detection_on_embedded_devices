## environment_detection_on_nrf52840/build/Kconfig/Kconfig.modules
```kconfig
menu "hal_nordic (/Users/hmartens/zephyrproject/modules/hal/nordic)"
osource "$(ZEPHYR_HAL_NORDIC_KCONFIG)"
config ZEPHYR_HAL_NORDIC_MODULE
	bool
	default y
endmenu
menu "mbedtls (/Users/hmartens/zephyrproject/modules/crypto/mbedtls)"
osource "$(ZEPHYR_MBEDTLS_KCONFIG)"
config ZEPHYR_MBEDTLS_MODULE
	bool
	default y
endmenu
menu "sof (/Users/hmartens/zephyrproject/modules/audio/sof)"
osource "/Users/hmartens/zephyrproject/modules/audio/sof/zephyr/Kconfig"
config ZEPHYR_SOF_MODULE
	bool
	default y
endmenu
menu "TraceRecorder (/Users/hmartens/zephyrproject/modules/debug/TraceRecorder)"
osource "/Users/hmartens/zephyrproject/modules/debug/TraceRecorder/kernelports/Zephyr/Kconfig"
config ZEPHYR_TRACERECORDER_MODULE
	bool
	default y
endmenu
menu "trusted-firmware-m (/Users/hmartens/zephyrproject/modules/tee/tfm)"
osource "$(ZEPHYR_TRUSTED_FIRMWARE_M_KCONFIG)"
config ZEPHYR_TRUSTED_FIRMWARE_M_MODULE
	bool
	default y
endmenu
menu "nanopb (/Users/hmartens/zephyrproject/modules/lib/nanopb)"
osource "$(ZEPHYR_NANOPB_KCONFIG)"
config ZEPHYR_NANOPB_MODULE
	bool
	default y
endmenu
menu "tensorflow (/Users/hmartens/zephyrproject/modules/lib/tensorflow)"
osource "$(ZEPHYR_TENSORFLOW_KCONFIG)"
config ZEPHYR_TENSORFLOW_MODULE
	bool
	default y
endmenu
```

## environment_detection_on_nrf52840/build/Kconfig/Kconfig.soc.arch
```kconfig
osource "/Users/hmartens/zephyrproject/zephyr/soc/$(ARCH)/Kconfig"
osource "/Users/hmartens/zephyrproject/zephyr/soc/$(ARCH)/*/Kconfig"
```
